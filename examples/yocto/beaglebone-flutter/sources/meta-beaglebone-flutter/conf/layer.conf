## examples/yocto/beaglebone-flutter/sources/meta-beaglebone-flutter/conf/layer.conf
```bitbake
BBPATH .= ":${LAYERDIR}"
BBFILES += "${LAYERDIR}/recipes-*/*/*.bb ${LAYERDIR}/recipes-*/*/*.bbappend"
BBFILE_COLLECTIONS += "beaglebone-flutter"
BBFILE_PATTERN_beaglebone-flutter = "^${LAYERDIR}/"
BBFILE_PRIORITY_beaglebone-flutter = "20"
LAYERSERIES_COMPAT_beaglebone-flutter = "dunfell"
```

## examples/yocto/raspberry/sources/meta-systemd-tweaks/conf/layer.conf
```bitbake
BBPATH .= ":${LAYERDIR}"
BBFILES += "${LAYERDIR}/recipes-*/*/*.bb ${LAYERDIR}/recipes-*/*/*.bbappend"
BBFILE_COLLECTIONS += "systemd-tweaks"
BBFILE_PATTERN_systemd-tweaks = "^${LAYERDIR}/"
BBFILE_FILE_PRIORITY_systemd-tweaks = "5"
LAYER_VERSION_systemd-tweaks = "4"
LAYERSERIES_COMPAT_systemd-tweaks = "dunfell"
```
